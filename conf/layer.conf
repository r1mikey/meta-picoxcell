## conf/layer.conf
```bitbake
BBPATH .= ":${LAYERDIR}"

# We have a recipes directory containing .bb and .bbappend files, add to BBFILES
BBFILES += "${LAYERDIR}/recipes-*/*/*.bb \
            ${LAYERDIR}/recipes-*/*/*.bbappend"

BBFILE_COLLECTIONS += "meta-picoxcell"
BBFILE_PATTERN_picoxcell := "^${LAYERDIR}/"
BBFILE_PRIORITY_picoxcell = "6"

## Additional license directories.
#LICENSE_PATH += "${LAYERDIR}/files/custom-licenses"
```

## conf/machine/include/arm/arch-armv6k.inc
```bitbake
DEFAULTTUNE ?= "armv6k"

TUNEVALID[armv6k] = "Enable instructions for ARMv6k"
TUNECONFLICTS[armv6k] = "armv4 armv5"
TUNE_CCARGS .= "${@bb.utils.contains("TUNE_FEATURES", "armv6k", " -march=armv6k", "", d)}"
MACHINEOVERRIDES =. "${@bb.utils.contains("TUNE_FEATURES", "armv6k", "armv6k:", "" ,d)}"

require conf/machine/include/arm/arch-armv6.inc

# Little Endian
AVAILTUNES += "armv6k-novfp armv6k"
ARMPKGARCH_tune-armv6k-novfp ?= "armv6k-novfp"
ARMPKGARCH_tune-armv6k ?= "armv6k"
TUNE_FEATURES_tune-armv6k-novfp ?= "armv6k"
TUNE_FEATURES_tune-armv6k ?= "${TUNE_FEATURES_tune-armv6k-novfp} vfp"
PACKAGE_EXTRA_ARCHS_tune-armv6k-novfp = "${PACKAGE_EXTRA_ARCHS_tune-armv6-novfp} armv6k"
PACKAGE_EXTRA_ARCHS_tune-armv6k = "${PACKAGE_EXTRA_ARCHS_tune-armv6} armv6k armv6k-vfp"

# Big Endian
AVAILTUNES += "armv6kb-novfp armv6kb"
ARMPKGARCH_tune-armv6kb-novfp ?= "armv6k"
ARMPKGARCH_tune-armv6kb ?= "armv6k"
TUNE_FEATURES_tune-armv6kb-novfp ?= "${TUNE_FEATURES_tune-armv6k-novfp} bigendian"
TUNE_FEATURES_tune-armv6kb ?= "${TUNE_FEATURES_tune-armv6k} bigendian"
PACKAGE_EXTRA_ARCHS_tune-armv6kb-novfp = "${PACKAGE_EXTRA_ARCHS_tune-armv6b-novfp} armv6kb"
PACKAGE_EXTRA_ARCHS_tune-armv6kb = "${PACKAGE_EXTRA_ARCHS_tune-armv6b} armv6kb armv6kb-vfp"
```

## conf/machine/include/pc73032.inc
```bitbake
require conf/machine/include/picoxcell.inc

UBOOT_CONFIG[nand] = "picochippc7302nand,ubi"
UBOOT_CONFIG[nor] = "picochippc7302nor,jffs2"

KERNEL_MODULE_AUTOLOAD_append = " otp_pc30xx"
```

## conf/machine/include/pc7308.inc
```bitbake
require conf/machine/include/picoxcell.inc

UBOOT_CONFIG[nand] = "picochippc7302nand,ubi"

KERNEL_MODULE_AUTOLOAD_append = " otp_pc30xx"
```

## conf/machine/include/picoxcell.inc
```bitbake
DEFAULTTUNE ?= "arm1176jzs"

require conf/machine/include/tune-arm1176jz-s.inc

SOC_FAMILY = "picoxcell"
include conf/machine/include/soc-family.inc

USE_VT = "0"
SERIAL_CONSOLES = "115200;ttyS0"

UBOOT_ENTRYPOINT ?= "0x00008000"
UBOOT_LOADADDRESS ?= "0x00008000"

UBOOT_CONFIG ??= "nor"
UBOOT_CONFIG_pc7302 ??= "nor nand"
UBOOT_CONFIG_pc73032 ??= "nor nand"
UBOOT_CONFIG_pc7308 = "nand"
UBOOT_CONFIG[nand] = "picochippc7302nand picochippc73032nand picochippc7308"
UBOOT_CONFIG[nor] = "picochippc7302nor picochippc73032nor"

KERNEL_IMAGETYPE ?= "uImage"
PREFERRED_PROVIDER_virtual/kernel ?= "linux-picochip"
PREFERRED_PROVIDER_u-boot = "u-boot-picochip"
PREFERRED_PROVIDER_virtual/bootloader = "u-boot-picochip"

_STORAGETECH_FSTYPE = '${@base_contains("UBOOT_CONFIG", "nor", "jffs2", "", d)}'
_STORAGETECH_FSTYPE += '${@base_contains("UBOOT_CONFIG", "nand", "ubi", "", d)}'
IMAGE_FSTYPES ?= 'tar.gz ${_STORAGETECH_FSTYPE}'
UBI_VOLNAME ?= "rootfs"
MKUBIFS_ARGS ?= "-m 2048 -e 126976 -c 528 "
UBINIZE_ARGS ?= "-m 2048 -p 128KiB"
JFFS2_ERASEBLOCK ?= "0x20000"

# PREFERRED_PROVIDER_virtual/kernel = "linux-yocto-dev"
# KERNEL_IMAGETYPE ?= "Image"
# KERNEL_CLASSES_append = " kernel-fitimage"

MACHINE_FEATURES ?= "serial"
MACHINE_FEATURES_BACKFILL_CONSIDERED ?= "rtc"
MACHINE_EXTRA_RRECOMMENDS += "kernel-modules"
DISTRO_FEATURES_BACKFILL_CONSIDERED ?= "pulseaudio bluez5"
DEPENDS_pn-packagegroup-core-boot += "virtual/bootloader"

KERNEL_MODULE_AUTOLOAD = " \
    picoif \
    dw_wdt \
    keystream \
    packetmanager \
    picoxcell-fuse \
    picogpio \
    picoxcell_spi \
    picoxcell_crypto \
    picoxcell-rng \
    "
```

## conf/machine/include/tune-arm1176jz-s.inc
```bitbake
DEFAULTTUNE ?= "armv6k-novfp"

require conf/machine/include/arm/arch-armv6k.inc

TUNEVALID[arm1176jzs] = "Enable arm1176jz-s specific processor optimizations"
TUNE_CCARGS += "${@bb.utils.contains("TUNE_FEATURES", "arm1176jzs", "-mtune=arm1176jz-s", "", d)}"

AVAILTUNES += "arm1176jzs"
TUNE_FEATURES_tune-arm1176jzs = "${TUNE_FEATURES_tune-armv6k-novfp} arm1176jzs"
ARMPKGARCH_tune-arm1176jzs = "arm1176jzs"
PACKAGE_EXTRA_ARCHS_tune-arm1176jzs = "${PACKAGE_EXTRA_ARCHS_tune-armv6k-novfp} arm1176jzs"
```

## conf/machine/pc7302.conf
```bitbake
#@TYPE: Machine
#@Name: picoChip PC7302 development platform.
#@DESCRIPTION: Machine configuration for the picoChip PC7302 development
#board.

require conf/machine/include/picoxcell.inc

KERNEL_MODULE_AUTOLOAD_append = " otp_pc3x3"
```

## conf/machine/pc7302nand.conf
```bitbake
#@TYPE: Machine
#@Name: picoChip PC7302 development platform.
#@DESCRIPTION: Machine configuration for the picoChip PC7302 development
#board.

UBOOT_CONFIG = "nand"

require conf/machine/include/pc7302.inc
```

## conf/machine/pc7302nor.conf
```bitbake
#@TYPE: Machine
#@Name: picoChip PC7302 development platform.
#@DESCRIPTION: Machine configuration for the picoChip PC7302 development
#board.

UBOOT_CONFIG = "nor"

require conf/machine/include/pc7302.inc
```

## conf/machine/pc73032.conf
```bitbake
#@TYPE: Machine
#@Name: picoChip PC73032 development platform.
#@DESCRIPTION: Machine configuration for the picoChip PC73032 development
#board.

require conf/machine/include/picoxcell.inc

KERNEL_MODULE_AUTOLOAD_append = " otp_pc30xx"
```

## conf/machine/pc73032nand.conf
```bitbake
#@TYPE: Machine
#@Name: picoChip PC73032 development platform.
#@DESCRIPTION: Machine configuration for the picoChip PC73032 development
#board.

UBOOT_CONFIG = "nand"

require conf/machine/include/pc73032.inc
```

## conf/machine/pc73032nor.conf
```bitbake
#@TYPE: Machine
#@Name: picoChip PC73032 development platform.
#@DESCRIPTION: Machine configuration for the picoChip PC73032 development
#board.

UBOOT_CONFIG = "nor"

require conf/machine/include/pc73032.inc
```

## conf/machine/pc7308.conf
```bitbake
#@TYPE: Machine
#@Name: picoChip PC7308 development platform.
#@DESCRIPTION: Machine configuration for the picoChip PC7308 development
#board.

UBOOT_CONFIG = "nand"

require conf/machine/include/pc7308.inc
```
